## examples/esp32/sdkconfig.defaults
```kconfig
# ============================================================
#  ESP32-S3 SDK 默认配置 (sdkconfig.defaults)
#
#  参考 xiaozhi-esp32 的 ESP32-S3 优化配置:
#  - QIO Flash 模式 (最大带宽)
#  - 240MHz CPU
#  - Octal PSRAM 80MHz
#  - 内存优化 (mbedTLS 使用外部 RAM)
#  - Wi-Fi 缓冲调优
# ============================================================

# ---- Flash ----
CONFIG_ESPTOOLPY_FLASHMODE_DIO=y
CONFIG_ESPTOOLPY_FLASHSIZE_16MB=y
CONFIG_ESPTOOLPY_FLASHSIZE="16MB"

# ---- CPU ----
CONFIG_ESP_DEFAULT_CPU_FREQ_MHZ_240=y

# ---- PSRAM ----
CONFIG_SPIRAM=y
CONFIG_SPIRAM_MODE_OCT=y
CONFIG_SPIRAM_SPEED_80M=y
CONFIG_SPIRAM_MALLOC_ALWAYSINTERNAL=2048
CONFIG_SPIRAM_MALLOC_RESERVE_INTERNAL=98304

# ---- mbedTLS ----
CONFIG_MBEDTLS_EXTERNAL_MEM_ALLOC=y
CONFIG_MBEDTLS_DYNAMIC_FREE_CONFIG_DATA=y
CONFIG_MBEDTLS_SSL_PROTO_TLS1_2=y
CONFIG_MBEDTLS_SSL_IN_CONTENT_LEN=16384
CONFIG_MBEDTLS_SSL_OUT_CONTENT_LEN=4096
CONFIG_MBEDTLS_ENTROPY_C=y
CONFIG_MBEDTLS_HARDWARE_AES=n

# ---- lwIP ----
CONFIG_LWIP_TCPIP_RECVMBOX_SIZE=16
CONFIG_LWIP_TCP_SND_BUF_DEFAULT=65534
CONFIG_LWIP_TCP_WND_DEFAULT=65534
CONFIG_LWIP_TCP_RECVMBOX_SIZE=16
CONFIG_LWIP_TCP_RTO_TIME=1500

# ---- Wi-Fi ----
CONFIG_ESP_WIFI_STATIC_RX_BUFFER_NUM=3
CONFIG_ESP_WIFI_DYNAMIC_RX_BUFFER_NUM=6
CONFIG_ESP_WIFI_RX_BA_WIN=3

# ---- FreeRTOS ----
CONFIG_FREERTOS_HZ=1000

# ---- 系统 ----
CONFIG_ESP_SYSTEM_EVENT_TASK_STACK_SIZE=4096
CONFIG_ESP_MAIN_TASK_STACK_SIZE=8192

# ---- Bootloader (参考 xiaozhi-esp32) ----
CONFIG_BOOTLOADER_SKIP_VALIDATE_ALWAYS=y
CONFIG_BOOTLOADER_LOG_LEVEL_NONE=y

# ---- 外设驱动 ----
CONFIG_I2C_ISR_IRAM_SAFE=n
CONFIG_SPI_MASTER_ISR_IN_IRAM=n
CONFIG_I2S_ISR_IRAM_SAFE=n

# ---- 分区表 ----
CONFIG_PARTITION_TABLE_CUSTOM=y
CONFIG_PARTITION_TABLE_CUSTOM_FILENAME="partitions.csv"
CONFIG_PARTITION_TABLE_FILENAME="partitions.csv"

# ---- 任务看门狗 ----
# 关闭 IDLE 任务看门狗检查：app_main 在阻塞式初始化（WiFi 配网/
# LVGL/SDK 启动）期间会长时间占用 CPU0，AP 配网模式下更会无限等待
# 手机配置，与 IDLE 看门狗监控天然冲突，故禁用以免误触发看门狗重启。
CONFIG_ESP_TASK_WDT_CHECK_IDLE_TASK_CPU0=n
CONFIG_ESP_TASK_WDT_CHECK_IDLE_TASK_CPU1=n
CONFIG_TASK_WDT_CHECK_IDLE_TASK_CPU0=n
CONFIG_TASK_WDT_CHECK_IDLE_TASK_CPU1=n
# 开启 panic：若已注册看门狗的任务卡死，触发 panic 重启并留下 backtrace，
# 而非静默挂死。IDLE 未注册所以不受影响。
CONFIG_ESP_TASK_WDT_PANIC=y
CONFIG_TASK_WDT_PANIC=y

# ---- LVGL 字体 ----
# 启用 16 号 Montserrat，供语音选择面板放大字号使用
CONFIG_LV_FONT_MONTSERRAT_16=y
# 默认字体用 Montserrat 14（英文），不要用 CJK 字体做默认
# 否则所有未显式指定字体的对象（主题、按钮内部 label 等）
# 都会用 CJK 字体渲染英文，显示效果不一致
CONFIG_LV_FONT_DEFAULT_MONTSERRAT_14=y
```

## src/platforms/esp_idf/cmake/components/main/Kconfig.projbuild
```kconfig
menu "Unified AI application"
config AI_AGENT_ID
    string "Agent ID"
    default ""
config AI_API_KEY
    string "API key (takes priority over product credentials)"
    default ""
config AI_PRODUCT_ID
    string "Product ID"
    default ""
config AI_PRODUCT_KEY
    string "Product key"
    default ""
config AI_PRODUCT_SECRET
    string "Product secret"
    default ""
config AI_SERVER_URL
    string "WebSocket URL (empty uses SDK default)"
    default ""
config AI_SPEAKER_VOLUME
    int "Speaker volume (%)"
    range 0 100
    default 70
config AI_PLAYBACK_KB
    int "Bounded G711A playback buffer in PSRAM (KiB)"
    range 16 512
    default 256
endmenu
```
